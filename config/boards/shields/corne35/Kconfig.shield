## config/boards/shields/corne35/Kconfig.shield
```kconfig
config SHIELD_CORNE35_D
    def_bool $(shields_list_contains,corne35_dongle)

config SHIELD_CORNE35_R
    def_bool $(shields_list_contains,corne35_right)

config SHIELD_CORNE35_L
    def_bool $(shields_list_contains,corne35_left)
```

## config/west.yml
```yaml
manifest:
  remotes:
    - name: petejohanson
      url-base: https://github.com/petejohanson
    - name: englmaxi
      url-base: https://github.com/englmaxi
  projects:
    - name: zmk
      remote: petejohanson
      revision: feat/pointers-move-scroll
      import: app/west.yml
    - name: zmk-dongle-display
      remote: englmaxi
      revision: main
  self:
    path: config
```
